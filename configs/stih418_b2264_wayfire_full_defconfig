## configs/stih418_b2264_wayfire_full_defconfig
```kconfig
BR2_arm=y
BR2_cortex_a9=y
BR2_ARM_ENABLE_NEON=y
BR2_ARM_ENABLE_VFP=y
BR2_PACKAGE_HOST_LINUX_HEADERS_CUSTOM_6_19=y
BR2_TOOLCHAIN_BUILDROOT_CXX=y
BR2_GCC_ENABLE_OPENMP=y
BR2_GLOBAL_PATCH_DIR="board/stmicroelectronics/stih418-b2264/patches"
BR2_TARGET_GENERIC_HOSTNAME="4kOpen"
BR2_TARGET_GENERIC_ISSUE="Welcome to Buildroot for the 4kOpen"
BR2_ROOTFS_DEVICE_CREATION_DYNAMIC_EUDEV=y
BR2_SYSTEM_BIN_SH_BASH=y
BR2_SYSTEM_DHCP="eth0"
BR2_TARGET_TZ_INFO=y
BR2_TARGET_TZ_ZONELIST="europe"
BR2_TARGET_LOCALTIME="Europe/Paris"
BR2_ROOTFS_OVERLAY="board/stmicroelectronics/stih418-b2264/rootfs_overlay"
BR2_ROOTFS_POST_BUILD_SCRIPT="board/stmicroelectronics/stih418-b2264/post-build.sh"
BR2_ROOTFS_POST_IMAGE_SCRIPT="board/stmicroelectronics/stih418-b2264/post-image.sh"
BR2_LINUX_KERNEL=y
BR2_LINUX_KERNEL_CUSTOM_VERSION=y
BR2_LINUX_KERNEL_CUSTOM_VERSION_VALUE="7.0"
BR2_LINUX_KERNEL_USE_CUSTOM_CONFIG=y
BR2_LINUX_KERNEL_CUSTOM_CONFIG_FILE="board/stmicroelectronics/stih418-b2264/linux.config"
BR2_LINUX_KERNEL_UIMAGE=y
BR2_LINUX_KERNEL_UIMAGE_LOADADDR="0x82008000"
BR2_LINUX_KERNEL_DTS_SUPPORT=y
BR2_LINUX_KERNEL_INTREE_DTS_NAME="st/stih418-b2264-box"
BR2_LINUX_KERNEL_NEEDS_HOST_OPENSSL=y
BR2_PACKAGE_BUSYBOX_SHOW_OTHERS=y
BR2_PACKAGE_ALSA_UTILS=y
BR2_PACKAGE_ALSA_UTILS_APLAY=y
BR2_PACKAGE_MPV=y
BR2_PACKAGE_PLY=y
BR2_PACKAGE_STRACE=y
BR2_PACKAGE_MTD=y
BR2_PACKAGE_LIBERATION=y
BR2_PACKAGE_ADWAITA_ICON_THEME=y
BR2_PACKAGE_HICOLOR_ICON_THEME=y
BR2_PACKAGE_CHOCOLATE_DOOM=y
BR2_PACKAGE_DOOM_WAD=y
BR2_PACKAGE_ENIGMA=y
BR2_PACKAGE_SUPERTUXKART=y
BR2_PACKAGE_GLMARK2=y
BR2_PACKAGE_KMSCUBE=y
BR2_PACKAGE_MESA3D_DEMOS=y
BR2_PACKAGE_WAYFIRE=y
BR2_PACKAGE_WAYFIRE_PLUGINS_EXTRA=y
BR2_PACKAGE_WF_SHELL=y
BR2_PACKAGE_WCM=y
BR2_PACKAGE_CAIRO_DOCK=y
BR2_PACKAGE_CAIRO_DOCK_PLUGINS=y
BR2_PACKAGE_ALACRITTY=y
BR2_PACKAGE_WAYVNC=y
BR2_PACKAGE_FB_TEST_APP=y
BR2_PACKAGE_FBSET=y
BR2_PACKAGE_CON2FBMAP=y
BR2_PACKAGE_OLED_MONITOR=y
BR2_PACKAGE_FREERDP=y
BR2_PACKAGE_FREERDP_SERVER=y
# BR2_PACKAGE_FREERDP_CLIENT_X11 is not set
BR2_PACKAGE_LIBGLVND=y
BR2_PACKAGE_MESA3D=y
BR2_PACKAGE_MESA3D_GALLIUM_DRIVER_LIMA=y
BR2_PACKAGE_MESA3D_OPENGL_GLX=y
BR2_PACKAGE_MESA3D_OPENGL_EGL=y
BR2_PACKAGE_MESA3D_OPENGL_ES=y
BR2_PACKAGE_SDL2_WAYLAND=y
BR2_PACKAGE_SDL2_KMSDRM=y
BR2_PACKAGE_SDL2_OPENGLES=y
BR2_PACKAGE_XORG7=y
BR2_PACKAGE_XAPP_XCLOCK=y
BR2_PACKAGE_XAPP_XEYES=y
BR2_PACKAGE_LINUX_FIRMWARE=y
BR2_PACKAGE_LINUX_FIRMWARE_RTL_81XX=y
BR2_PACKAGE_LM_SENSORS=y
BR2_PACKAGE_UBOOT_TOOLS=y
BR2_PACKAGE_UBOOT_TOOLS_FIT_SUPPORT=y
BR2_PACKAGE_LIBBTFMW_H418=y
BR2_PACKAGE_CA_CERTIFICATES=y
BR2_PACKAGE_LIBDRM_INSTALL_TESTS=y
# BR2_PACKAGE_LIBGTK3_BROADWAY is not set
BR2_PACKAGE_WLROOTS_XWAYLAND=y
BR2_PACKAGE_LIBV4L=y
BR2_PACKAGE_LIBV4L_UTILS=y
BR2_PACKAGE_XERCES=y
BR2_PACKAGE_BOOST=y
BR2_PACKAGE_BOOST_SYSTEM=y
BR2_PACKAGE_DROPBEAR=y
BR2_PACKAGE_ETHTOOL=y
BR2_PACKAGE_IW=y
BR2_PACKAGE_NTP=y
BR2_PACKAGE_WIRELESS_TOOLS=y
BR2_PACKAGE_WPA_SUPPLICANT=y
BR2_PACKAGE_WPA_SUPPLICANT_CLI=y
BR2_PACKAGE_WPA_SUPPLICANT_WPA_CLIENT_SO=y
BR2_PACKAGE_WPA_SUPPLICANT_PASSPHRASE=y
BR2_PACKAGE_SCREEN=y
BR2_PACKAGE_WLR_RANDR=y
BR2_PACKAGE_HTOP=y
BR2_PACKAGE_PROCPS_NG=y
BR2_PACKAGE_WATCHDOG=y
BR2_TARGET_ROOTFS_EXT2=y
BR2_TARGET_ROOTFS_EXT2_4=y
BR2_TARGET_ROOTFS_EXT2_SIZE="1450M"
BR2_TARGET_UBOOT=y
BR2_TARGET_UBOOT_BUILD_SYSTEM_KCONFIG=y
BR2_TARGET_UBOOT_CUSTOM_VERSION=y
BR2_TARGET_UBOOT_CUSTOM_VERSION_VALUE="2025.04"
BR2_TARGET_UBOOT_BOARD_DEFCONFIG="stih418-b2264"
BR2_TARGET_UBOOT_NEEDS_DTC=y
# BR2_TARGET_UBOOT_FORMAT_BIN is not set
BR2_TARGET_UBOOT_FORMAT_IMG=y
BR2_TARGET_UBOOT_SPL=y
BR2_PACKAGE_HOST_DOSFSTOOLS=y
BR2_PACKAGE_HOST_ENVIRONMENT_SETUP=y
BR2_PACKAGE_HOST_GENIMAGE=y
BR2_PACKAGE_HOST_MTOOLS=y
BR2_PACKAGE_HOST_UBOOT_TOOLS_ENVIMAGE=y
BR2_PACKAGE_HOST_UBOOT_TOOLS_ENVIMAGE_SOURCE="board/stmicroelectronics/stih418-b2264/uboot-env.txt"
BR2_PACKAGE_HOST_UBOOT_TOOLS_ENVIMAGE_SIZE="0x4000"
```

## configs/stm32mp257f_ev1_defconfig
```kconfig
BR2_aarch64=y
BR2_cortex_a35=y
BR2_TOOLCHAIN_EXTERNAL=y
BR2_TOOLCHAIN_EXTERNAL_BOOTLIN=y
BR2_TOOLCHAIN_EXTERNAL_BOOTLIN_AARCH64_GLIBC_STABLE=y
BR2_GLOBAL_PATCH_DIR="board/stmicroelectronics/common/stm32mp2xx/patches"
BR2_DOWNLOAD_FORCE_CHECK_HASHES=y
BR2_ROOTFS_DEVICE_CREATION_DYNAMIC_MDEV=y
BR2_ROOTFS_OVERLAY="board/stmicroelectronics/stm32mp257f-ev1/overlay/"
BR2_ROOTFS_POST_IMAGE_SCRIPT="board/stmicroelectronics/common/stm32mp2xx/post-image.sh"
BR2_LINUX_KERNEL=y
BR2_LINUX_KERNEL_CUSTOM_VERSION=y
BR2_LINUX_KERNEL_CUSTOM_VERSION_VALUE="6.18.8"
BR2_LINUX_KERNEL_USE_CUSTOM_CONFIG=y
BR2_LINUX_KERNEL_CUSTOM_CONFIG_FILE="board/stmicroelectronics/stm32mp257f-ev1/linux.config"
BR2_LINUX_KERNEL_IMAGEGZ=y
BR2_LINUX_KERNEL_DTS_SUPPORT=y
BR2_LINUX_KERNEL_INTREE_DTS_NAME="st/stm32mp257f-ev1"
BR2_LINUX_KERNEL_INSTALL_TARGET=y
BR2_LINUX_KERNEL_NEEDS_HOST_OPENSSL=y
BR2_TARGET_ROOTFS_EXT2=y
BR2_TARGET_ROOTFS_EXT2_4=y
BR2_TARGET_ROOTFS_EXT2_SIZE="200M"
# BR2_TARGET_ROOTFS_TAR is not set
BR2_TARGET_ARM_TRUSTED_FIRMWARE=y
BR2_TARGET_ARM_TRUSTED_FIRMWARE_CUSTOM_VERSION=y
BR2_TARGET_ARM_TRUSTED_FIRMWARE_CUSTOM_VERSION_VALUE="v2.14"
BR2_TARGET_ARM_TRUSTED_FIRMWARE_PLATFORM="stm32mp2"
BR2_TARGET_ARM_TRUSTED_FIRMWARE_FIP=y
BR2_TARGET_ARM_TRUSTED_FIRMWARE_BL32_OPTEE=y
BR2_TARGET_ARM_TRUSTED_FIRMWARE_UBOOT_AS_BL33=y
BR2_TARGET_ARM_TRUSTED_FIRMWARE_UBOOT_BL33_IMAGE="u-boot-nodtb.bin"
BR2_TARGET_ARM_TRUSTED_FIRMWARE_ADDITIONAL_VARIABLES="STM32MP_DDR4_TYPE=1 DTB_FILE_NAME=stm32mp257f-ev1.dtb STM32MP_SDMMC=1 BL32_EXTRA2= BL33_CFG=$(BINARIES_DIR)/u-boot.dtb"
BR2_TARGET_ARM_TRUSTED_FIRMWARE_IMAGES="*.bin *.stm32"
BR2_TARGET_ARM_TRUSTED_FIRMWARE_NEEDS_DTC=y
BR2_TARGET_OPTEE_OS=y
BR2_TARGET_OPTEE_OS_CUSTOM_VERSION=y
BR2_TARGET_OPTEE_OS_CUSTOM_VERSION_VALUE="4.9.0"
BR2_TARGET_OPTEE_OS_NEEDS_DTC=y
BR2_TARGET_OPTEE_OS_NEEDS_PYTHON_CRYPTOGRAPHY=y
BR2_TARGET_OPTEE_OS_NEEDS_CMAKE=y
BR2_TARGET_OPTEE_OS_PLATFORM="stm32mp2"
BR2_TARGET_OPTEE_OS_PLATFORM_FLAVOR="257F_EV1"
BR2_TARGET_OPTEE_OS_ADDITIONAL_VARIABLES="CFG_WITH_TUI=n CFG_SCMI_SCPFW=n"
BR2_TARGET_UBOOT=y
BR2_TARGET_UBOOT_BUILD_SYSTEM_KCONFIG=y
BR2_TARGET_UBOOT_CUSTOM_VERSION=y
BR2_TARGET_UBOOT_CUSTOM_VERSION_VALUE="2026.01"
BR2_TARGET_UBOOT_BOARD_DEFCONFIG="stm32mp25"
BR2_TARGET_UBOOT_NEEDS_OPENSSL=y
BR2_TARGET_UBOOT_NEEDS_GNUTLS=y
# BR2_TARGET_UBOOT_FORMAT_BIN is not set
BR2_TARGET_UBOOT_FORMAT_CUSTOM=y
BR2_TARGET_UBOOT_FORMAT_CUSTOM_NAME="u-boot-nodtb.bin u-boot.dtb"
BR2_TARGET_UBOOT_CUSTOM_MAKEOPTS="DEVICE_TREE=st/stm32mp257f-ev1"
BR2_PACKAGE_HOST_BMAP_TOOLS=y
BR2_PACKAGE_HOST_GENIMAGE=y
```

## package/aml/Config.in
```kconfig
config BR2_PACKAGE_AML
	bool "aml"
	help
	  Andri's Main Loop library. Une bibliothèque de boucle 
	  d'événements générique utilisée par neatvnc.

	  https://github.com/any1/aml
```

## package/cairo-dock-plugins/Config.in
```kconfig
config BR2_PACKAGE_CAIRO_DOCK_PLUGINS
	bool "cairo-dock-plugins"
	depends on BR2_PACKAGE_CAIRO_DOCK
	select BR2_PACKAGE_LIBXML2
	select BR2_PACKAGE_LIBCURL
	help
	  Plugins additionnels pour Cairo-Dock (Météo, Terminal, 
	  Monitoring, etc.).

	  https://github.com/Cairo-Dock/cairo-dock-plugins
```

## package/cairo-dock/Config.in
```kconfig
config BR2_PACKAGE_CAIRO_DOCK
	bool "cairo-dock"
	depends on BR2_PACKAGE_HAS_LIBGL
	depends on BR2_PACKAGE_LIBGTK3
	select BR2_PACKAGE_LIBCAIRO
	select BR2_PACKAGE_LIBGLIB2
	select BR2_PACKAGE_LIBRSVG
	select BR2_PACKAGE_DBUS
	select BR2_PACKAGE_LIBGLU
	select BR2_PACKAGE_LIBCURL
	select BR2_PACKAGE_DBUS_GLIB
	select BR2_PACKAGE_WAYLAND
	select BR2_PACKAGE_WAYLAND_PROTOCOLS
	select BR2_PACKAGE_LIBXKBCOMMON
	select BR2_PACKAGE_XLIB_LIBXCOMPOSITE if BR2_PACKAGE_XORG7
	select BR2_PACKAGE_JSON_C if BR2_PACKAGE_WAYFIRE
	select BR2_PACKAGE_EXTRA_CMAKE_MODULES
	select BR2_PACKAGE_GTK_LAYER_SHELL
	help
	  Cairo-Dock est une barre de lancement animée.
	  La version 3.6.x apporte le support natif de Wayland via 
	  le protocole layer-shell.

	  https://github.com/Cairo-Dock/cairo-dock-core

comment "cairo-dock needs a toolchain w/ GTK3, OpenGL and Wayland"
	depends on !BR2_PACKAGE_HAS_LIBGL || !BR2_PACKAGE_LIBGTK3 || !BR2_PACKAGE_WAYLAND
```

## package/con2fbmap/Config.in
```kconfig
config BR2_PACKAGE_CON2FBMAP
	bool "con2fbmap"
	help
	  A utility to map virtual consoles to framebuffers.
	  
	  Usage: con2fbmap console [framebuffer]
	  
	  Useful for embedding graphical applications on specific
	  framebuffers (like OLED screens) while keeping the console
	  elsewhere, or mapping the console to the OLED.
```

## package/extra-cmake-modules/Config.in
```kconfig
config BR2_PACKAGE_EXTRA_CMAKE_MODULES
	bool "extra-cmake-modules"
	help
	  Extra CMake Modules (ECM) contient des modules qui 
	  fournissent des fonctionnalités supplémentaires à CMake.

	  https://github.com/KDE/extra-cmake-modules
```

## package/gtk-layer-shell/Config.in
```kconfig
config BR2_PACKAGE_GTK_LAYER_SHELL
	bool "gtk-layer-shell"
	depends on BR2_PACKAGE_LIBGTK3
	depends on BR2_PACKAGE_WAYLAND
	help
	  Library to create panels and other desktop components 
	  using GTK on Wayland.

	  https://github.com/wmww/gtk-layer-shell
```

## package/libbtfmw_h418/Config.in
```kconfig
config BR2_PACKAGE_LIBBTFMW_H418
    bool "libbtfmw-h418"
    help
      This package extracts the libbtfmw-h418.a file from a nested archive.
```

## package/neatvnc/Config.in
```kconfig
config BR2_PACKAGE_NEATVNC
	bool "neatvnc"
	select BR2_PACKAGE_AML
	select BR2_PACKAGE_PIXMAN
	select BR2_PACKAGE_LIBDRM
	select BR2_PACKAGE_ZLIB
	help
	  A TLS-based VNC server library.

	  https://github.com/any1/neatvnc
```

## package/oled_monitor/Config.in
```kconfig
config BR2_PACKAGE_OLED_MONITOR
	bool "oled_monitor"
	select BR2_PACKAGE_NCURSES
	help
	  Lightweight OLED system monitor (CPU/Network).
	  Version without NetworkManager dependency.

	  Displays CPU usage and basic network info on SSD1307.
```

## package/wayfire-plugins-extra/Config.in
```kconfig
config BR2_PACKAGE_WAYFIRE_PLUGINS_EXTRA
	bool "wayfire-plugins-extra"
	depends on !BR2_STATIC_LIBS # wlroots
	depends on BR2_TOOLCHAIN_HAS_THREADS # pango, wlroots
	depends on BR2_PACKAGE_HAS_LIBEGL # wlroots
	depends on BR2_PACKAGE_HAS_LIBGLES # wlroots
	depends on BR2_PACKAGE_HAS_UDEV # wlroots
	depends on BR2_TOOLCHAIN_HAS_SYNC_4 # pango
	depends on BR2_USE_WCHAR # pango
	depends on BR2_USE_MMU # pango
	depends on BR2_INSTALL_LIBSTDCPP # pango
	depends on BR2_TOOLCHAIN_GCC_AT_LEAST_4_9 # pango
	depends on BR2_TOOLCHAIN_HAS_OPENMP
	depends on BR2_PACKAGE_BOOST
	depends on BR2_PACKAGE_WAYFIRE
	help
	  Additional plugins for Wayfire

	  This is a place for plugins that have external dependencies,
	  debugging purposes or otherwise will not be included with
	  wayfire core plugins.

	  https://github.com/WayfireWM/wayfire-plugins-extra
```

## package/wayvnc/Config.in
```kconfig
config BR2_PACKAGE_WAYVNC
	bool "wayvnc"
	depends on BR2_PACKAGE_WAYLAND
	select BR2_PACKAGE_AML
	select BR2_PACKAGE_NEATVNC
	select BR2_PACKAGE_PIXMAN
	select BR2_PACKAGE_JANSSON
	select BR2_PACKAGE_LIBXKBCOMMON
	help
	  VNC server for wlroots-based Wayland compositors.

	  https://github.com/any1/wayvnc
```

## package/yyjson/Config.in
```kconfig
config BR2_PACKAGE_YYJSON
	bool "yyjson"
	help
	  yyjson is a high-performance JSON library written in C.

	  https://github.com/ibireme/yyjson
```
